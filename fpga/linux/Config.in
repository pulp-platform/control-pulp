## fpga/linux/Config.in
```kconfig
source "$BR2_EXTERNAL_CPULP_PATH/package/Config.in"

source "$BR2_EXTERNAL_CPULP_PATH/package/pmsctl/Config.in"
source "$BR2_EXTERNAL_CPULP_PATH/package/pmsrst/Config.in"
source "$BR2_EXTERNAL_CPULP_PATH/package/libpulp/Config.in"
source "$BR2_EXTERNAL_CPULP_PATH/package/pulp-driver/Config.in"
source "$BR2_EXTERNAL_CPULP_PATH/package/zynq-mkbootimage/Config.in.host"

config BR2_CPULP_AUTHORIZED_KEYS
  string "Optional authorized keys file to install"
  help
    Authorized keys file to install for automatic SSH access.
    Leave empty to not install any authorized keys.

config BR2_CPULP_BITSTREAM
  string "Optional bitstream to load for targeted FPGA"
  help
    Location of a bitstream to load for the FPGA device during
    boot.  Leave empty to not load any bitstream.

config BR2_CPULP_EXT_MOUNT
  string "External mount point to load for chrooting"
  help
    Location to mount as external root, for example NFS partition.
    Binds system to the filesystem.  Options can be specified
    before (with -o) as the options are completely forwarded to
    mount.  Leave empty to not mount external partition.
```

## fpga/linux/configs/har_exilzcu102_defconfig
```kconfig
BR2_aarch64=y
BR2_GLOBAL_PATCH_DIR="board/zynqmp/patches/"
BR2_TOOLCHAIN_EXTERNAL=y
BR2_TOOLCHAIN_EXTERNAL_CUSTOM=y
BR2_TOOLCHAIN_EXTERNAL_PATH="$(CPULP_INSTALL)"
BR2_TOOLCHAIN_EXTERNAL_CUSTOM_PREFIX="aarch64-none-linux-gnu"
BR2_TOOLCHAIN_EXTERNAL_GCC_8=y
BR2_TOOLCHAIN_EXTERNAL_HEADERS_4_19=y
BR2_TOOLCHAIN_EXTERNAL_CUSTOM_GLIBC=y
BR2_TOOLCHAIN_EXTERNAL_CXX=y
BR2_TARGET_GENERIC_HOSTNAME="zynqmp"
BR2_TARGET_GENERIC_ISSUE="Welcome to ZynqMP"
BR2_TARGET_GENERIC_ROOT_PASSWD="change-this-root-pw"
BR2_SYSTEM_BIN_SH_BASH=y
BR2_ROOTFS_OVERLAY="$(BR2_EXTERNAL_CPULP_PATH)/board/common/overlay/"
BR2_ROOTFS_POST_BUILD_SCRIPT="$(BR2_EXTERNAL_CPULP_PATH)/board/common/post_build.sh $(BR2_EXTERNAL_CPULP_PATH)/board/xilzcu102/post_build.sh"
BR2_ROOTFS_POST_IMAGE_SCRIPT="$(BR2_EXTERNAL_CPULP_PATH)/board/xilzcu102/post_image.sh"
BR2_LINUX_KERNEL=y
BR2_LINUX_KERNEL_CUSTOM_GIT=y
BR2_LINUX_KERNEL_CUSTOM_REPO_URL="git://github.com/Xilinx/linux-xlnx.git"
BR2_LINUX_KERNEL_CUSTOM_REPO_VERSION="xilinx-v2019.2.01"
BR2_LINUX_KERNEL_DEFCONFIG="xilinx_zynqmp"
BR2_LINUX_KERNEL_CONFIG_FRAGMENT_FILES="$(BR2_EXTERNAL_CPULP_PATH)/board/xilzcu102/kernel_config"
BR2_LINUX_KERNEL_DTS_SUPPORT=y
BR2_LINUX_KERNEL_INTREE_DTS_NAME="xilinx/zynqmp-zcu102-revB"
BR2_LINUX_KERNEL_CUSTOM_DTS_PATH="${BR2_EXTERNAL_CPULP_PATH}/board/xilzcu102/control_pulp.dtsi ${BR2_EXTERNAL_CPULP_PATH}/board/xilzcu102/control_pulp.dts"
BR2_PACKAGE_BUSYBOX_SHOW_OTHERS=y
BR2_PACKAGE_NFS_UTILS=y
BR2_PACKAGE_PYTHON3=y
BR2_PACKAGE_PYTHON3_READLINE=y
BR2_PACKAGE_PYTHON3_SSL=y
BR2_PACKAGE_LIBNFS=y
BR2_PACKAGE_BC=y
BR2_PACKAGE_DROPBEAR=y
BR2_PACKAGE_IPROUTE2=y
BR2_PACKAGE_RSYNC=y
BR2_PACKAGE_ZSH=y
BR2_PACKAGE_BASH_COMPLETION=y
BR2_TARGET_ROOTFS_EXT2=y
BR2_TARGET_ROOTFS_EXT2_4=y
BR2_PACKAGE_HOST_DOSFSTOOLS=y
BR2_PACKAGE_HOST_GENIMAGE=y
BR2_PACKAGE_HOST_MTOOLS=y
BR2_PACKAGE_PMSCTL=y
BR2_PACKAGE_PMSRST=y
BR2_PACKAGE_HOST_ZYNQ_MKBOOTIMAGE=y
BR2_CPULP_BITSTREAM="$(BR2_EXTERNAL_CPULP_PATH)/../output/pms.bit"
```

## fpga/linux/package/pmsctl/Config.in
```kconfig
config BR2_PACKAGE_PMSCTL
	bool "pmsctl: PMS load/run/debugging tool"

comment "pmsctl needs a well-defined CPULP platform"
	depends on BR2_PACKAGE_CPULP_PLATFORM = ""

if BR2_PACKAGE_PMSCTL

config BR2_PACKAGE_PMSCTL_DEBUG_LEVEL
	int "pmctl debug level"
	default 1
	help
	  Debug level for pmsctl.  Higher is more
	  verbose.  If more than zero, the binaries are also compiled
	  with debugging symbols.

endif
```

## fpga/linux/package/pmsrst/Config.in
```kconfig
config BR2_PACKAGE_PMSRST
	bool "pmsrst: PMS reset from host"

comment "pmsrst needs a well-defined CPULP platform"
	depends on BR2_PACKAGE_CPULP_PLATFORM = ""

if BR2_PACKAGE_PMSRST

config BR2_PACKAGE_PMSRST_DEBUG_LEVEL
	int "pmsrst debug level"
	default 1
	help
	  Debug level for pmsrst.  Higher is more
	  verbose.  If more than zero, the binaries are also compiled
	  with debugging symbols.

endif
```
